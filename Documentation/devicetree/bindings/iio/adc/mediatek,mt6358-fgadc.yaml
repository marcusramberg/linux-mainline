## Documentation/devicetree/bindings/iio/adc/mediatek,mt6358-fgadc.yaml
```yaml
# SPDX-License-Identifier: (GPL-2.0 OR BSD-2-Clause)
%YAML 1.2
---
$id: http://devicetree.org/schemas/iio/adc/mediatek,mt6358-fgadc.yaml#
$schema: http://devicetree.org/meta-schemas/core.yaml#

title: MediaTek MT6358 PMIC fuel gauge ADC

maintainers:
  - Marcus Ramberg <marcus@means.no>

description:
  The fuel gauge ADC (FGADC) of the MT6358 PMIC measures the battery
  current across an external sense resistor.

properties:
  compatible:
    const: mediatek,mt6358-fgadc

  "#io-channel-cells":
    const: 0

  shunt-resistor-micro-ohms:
    description: Value of the battery current sense resistor.

required:
  - compatible
  - "#io-channel-cells"
  - shunt-resistor-micro-ohms

additionalProperties: false
```

## Documentation/devicetree/bindings/iio/light/liteon,ltr569.yaml
```yaml
# SPDX-License-Identifier: (GPL-2.0-only OR BSD-2-Clause)
%YAML 1.2
---
$id: http://devicetree.org/schemas/iio/light/liteon,ltr569.yaml#
$schema: http://devicetree.org/meta-schemas/core.yaml#

title: Lite-On LTR-569 ambient light and proximity sensor

maintainers:
  - Marcus Ramberg <marcus@means.no>

allOf:
  - $ref: ../common.yaml#

properties:
  compatible:
    const: liteon,ltr569

  reg:
    maxItems: 1

  interrupts:
    maxItems: 1

  vdd-supply:
    description: Regulator that provides power to the sensor.

  proximity-near-level: true

required:
  - compatible
  - reg

additionalProperties: false

examples:
  - |
    i2c {
        #address-cells = <1>;
        #size-cells = <0>;

        light-sensor@23 {
            compatible = "liteon,ltr569";
            reg = <0x23>;
            proximity-near-level = <1500>;
        };
    };
```

## Documentation/devicetree/bindings/iio/magnetometer/qst,qmc6308.yaml
```yaml
# SPDX-License-Identifier: (GPL-2.0-only OR BSD-2-Clause)
%YAML 1.2
---
$id: http://devicetree.org/schemas/iio/magnetometer/qst,qmc6308.yaml#
$schema: http://devicetree.org/meta-schemas/core.yaml#

title: QST QMC6308 3-axis magnetometer

maintainers:
  - Marcus Ramberg <marcus@means.no>

properties:
  compatible:
    const: qst,qmc6308

  reg:
    maxItems: 1

  mount-matrix:
    description: An optional 3x3 mounting rotation matrix.

required:
  - compatible
  - reg

additionalProperties: false

examples:
  - |
    i2c {
        #address-cells = <1>;
        #size-cells = <0>;

        magnetometer@2c {
            compatible = "qst,qmc6308";
            reg = <0x2c>;
        };
    };
```

## Documentation/devicetree/bindings/media/i2c/galaxycore,gc32e1.yaml
```yaml
# SPDX-License-Identifier: (GPL-2.0-only OR BSD-2-Clause)
%YAML 1.2
---
$id: http://devicetree.org/schemas/media/i2c/galaxycore,gc32e1.yaml#
$schema: http://devicetree.org/meta-schemas/core.yaml#

title: GalaxyCore GC32E1 CMOS Image Sensor

maintainers:
  - Marcus Ramberg <marcus@means.no>

description:
  The GalaxyCore GC32E1 is a 32 megapixel (6528x4896) CMOS image sensor
  controlled over I2C, with a four lane MIPI CSI-2 D-PHY output.

allOf:
  - $ref: /schemas/media/video-interface-devices.yaml#

properties:
  compatible:
    const: galaxycore,gc32e1

  reg:
    maxItems: 1

  clocks:
    description: Input clock (24 MHz)
    maxItems: 1

  avdd-supply:
    description: Analog power supply (2.8 V)

  dovdd-supply:
    description: Interface power supply (1.8 V)

  dvdd-supply:
    description: Digital core power supply (1.2 V)

  reset-gpios:
    description: Sensor reset GPIO
    maxItems: 1

  port:
    $ref: /schemas/graph.yaml#/$defs/port-base
    unevaluatedProperties: false

    properties:
      endpoint:
        $ref: /schemas/media/video-interfaces.yaml#
        unevaluatedProperties: false

        properties:
          data-lanes:
            items:
              - const: 1
              - const: 2
              - const: 3
              - const: 4

        required:
          - data-lanes
          - link-frequencies

    required:
      - endpoint

required:
  - compatible
  - reg
  - clocks
  - avdd-supply
  - dovdd-supply
  - dvdd-supply
  - port

unevaluatedProperties: false

examples:
  - |
    #include <dt-bindings/gpio/gpio.h>

    i2c {
        #address-cells = <1>;
        #size-cells = <0>;

        camera@4a {
            compatible = "galaxycore,gc32e1";
            reg = <0x4a>;
            clocks = <&camera_mclk>;
            reset-gpios = <&pio 109 GPIO_ACTIVE_LOW>;
            avdd-supply = <&vcama2>;
            dovdd-supply = <&vcamio>;
            dvdd-supply = <&cam_dvdd>;

            port {
                endpoint {
                    remote-endpoint = <&csi2_ep>;
                    data-lanes = <1 2 3 4>;
                    link-frequencies = /bits/ 64 <403200000>;
                };
            };
        };
    };
...
```

## Documentation/devicetree/bindings/media/i2c/smartsens,sc520cs.yaml
```yaml
# SPDX-License-Identifier: (GPL-2.0-only OR BSD-2-Clause)
%YAML 1.2
---
$id: http://devicetree.org/schemas/media/i2c/smartsens,sc520cs.yaml#
$schema: http://devicetree.org/meta-schemas/core.yaml#

title: SmartSens SC520CS CMOS Image Sensor

maintainers:
  - Marcus Ramberg <marcus@means.no>

description:
  The SmartSens SC520CS is a 5 megapixel (2592x1944) RAW10 CMOS image sensor
  controlled over I2C, with a two lane MIPI CSI-2 D-PHY output.

allOf:
  - $ref: /schemas/media/video-interface-devices.yaml#

properties:
  compatible:
    const: smartsens,sc520cs

  reg:
    maxItems: 1

  clocks:
    description: Input clock (24 MHz)
    maxItems: 1

  avdd-supply:
    description: Analog power supply (2.8 V)

  dovdd-supply:
    description: Interface power supply (1.8 V)

  dvdd-supply:
    description: Digital core power supply (1.2 V)

  reset-gpios:
    maxItems: 1

  powerdown-gpios:
    maxItems: 1

  port:
    $ref: /schemas/graph.yaml#/$defs/port-base
    unevaluatedProperties: false

    properties:
      endpoint:
        $ref: /schemas/media/video-interfaces.yaml#
        unevaluatedProperties: false

        properties:
          data-lanes:
            items:
              - const: 1
              - const: 2

        required:
          - data-lanes
          - link-frequencies

    required:
      - endpoint

required:
  - compatible
  - reg
  - clocks
  - avdd-supply
  - dovdd-supply
  - dvdd-supply
  - port

unevaluatedProperties: false

examples:
  - |
    #include <dt-bindings/gpio/gpio.h>

    i2c {
        #address-cells = <1>;
        #size-cells = <0>;

        camera@36 {
            compatible = "smartsens,sc520cs";
            reg = <0x36>;
            clocks = <&camera_mclk>;
            reset-gpios = <&pio 102 GPIO_ACTIVE_LOW>;
            avdd-supply = <&vcama2>;
            dovdd-supply = <&vcamio>;
            dvdd-supply = <&cam_dvdd>;

            port {
                endpoint {
                    remote-endpoint = <&csi1_ep>;
                    data-lanes = <1 2>;
                    link-frequencies = /bits/ 64 <450000000>;
                };
            };
        };
    };
...
```

## Documentation/devicetree/bindings/media/i2c/sony,imx882.yaml
```yaml
# SPDX-License-Identifier: (GPL-2.0-only OR BSD-2-Clause)
%YAML 1.2
---
$id: http://devicetree.org/schemas/media/i2c/sony,imx882.yaml#
$schema: http://devicetree.org/meta-schemas/core.yaml#

title: Sony IMX882 CMOS Image Sensor

maintainers:
  - Marcus Ramberg <marcus@means.no>

description:
  The Sony IMX882 is a 50 megapixel (8192x6144) quad Bayer CMOS image sensor
  controlled over I2C, with a four lane MIPI CSI-2 D-PHY output.

allOf:
  - $ref: /schemas/media/video-interface-devices.yaml#

properties:
  compatible:
    const: sony,imx882

  reg:
    maxItems: 1

  clocks:
    description: Input clock (24 MHz)
    maxItems: 1

  avdd-supply:
    description: Analog power supply (2.8 V)

  dovdd-supply:
    description: Interface power supply (1.8 V)

  dvdd-supply:
    description: Digital core power supply (1.1 V)

  reset-gpios:
    description: Sensor reset (XCLR) GPIO
    maxItems: 1

  port:
    $ref: /schemas/graph.yaml#/$defs/port-base
    unevaluatedProperties: false

    properties:
      endpoint:
        $ref: /schemas/media/video-interfaces.yaml#
        unevaluatedProperties: false

        properties:
          data-lanes:
            items:
              - const: 1
              - const: 2
              - const: 3
              - const: 4

        required:
          - data-lanes
          - link-frequencies

    required:
      - endpoint

required:
  - compatible
  - reg
  - clocks
  - avdd-supply
  - dovdd-supply
  - dvdd-supply
  - port

unevaluatedProperties: false

examples:
  - |
    #include <dt-bindings/gpio/gpio.h>

    i2c {
        #address-cells = <1>;
        #size-cells = <0>;

        camera@10 {
            compatible = "sony,imx882";
            reg = <0x10>;
            clocks = <&camera_mclk>;
            reset-gpios = <&pio 101 GPIO_ACTIVE_LOW>;
            avdd-supply = <&vcama1>;
            dovdd-supply = <&vcamio>;
            dvdd-supply = <&vcamd>;
            lens-focus = <&vcm>;

            port {
                endpoint {
                    remote-endpoint = <&csi0_ep>;
                    data-lanes = <1 2 3 4>;
                    link-frequencies = /bits/ 64 <500000000>;
                };
            };
        };
    };
...
```

## Documentation/devicetree/bindings/net/bluetooth/mediatek,mt6768-bluetooth.yaml
```yaml
# SPDX-License-Identifier: GPL-2.0-only OR BSD-2-Clause
%YAML 1.2
---
$id: http://devicetree.org/schemas/net/bluetooth/mediatek,mt6768-bluetooth.yaml#
$schema: http://devicetree.org/meta-schemas/core.yaml#

title: MediaTek MT6768 CONNSYS Bluetooth

maintainers:
  - Marcus Ramberg <marcus@means.no>

description:
  Bluetooth of the MT6768 connectivity subsystem (CONNSYS), reached over
  BTIF, so a child of the BTIF serial node. CONNSYS itself, whose MCU
  Bluetooth shares with Wi-Fi, GPS and FM, is described by
  Documentation/devicetree/bindings/soc/mediatek/mediatek,mt6768-connsys.yaml.

allOf:
  - $ref: bluetooth-controller.yaml#

properties:
  compatible:
    const: mediatek,mt6768-bluetooth

  mediatek,connsys:
    $ref: /schemas/types.yaml#/definitions/phandle
    description: The CONNSYS node.

required:
  - compatible
  - mediatek,connsys

unevaluatedProperties: false

examples:
  - |
    serial {
        bluetooth {
            compatible = "mediatek,mt6768-bluetooth";
            mediatek,connsys = <&connsys>;
        };
    };
```

## Documentation/devicetree/bindings/soc/mediatek/mediatek,mt6768-connsys.yaml
```yaml
# SPDX-License-Identifier: GPL-2.0-only OR BSD-2-Clause
%YAML 1.2
---
$id: http://devicetree.org/schemas/soc/mediatek/mediatek,mt6768-connsys.yaml#
$schema: http://devicetree.org/meta-schemas/core.yaml#

title: MediaTek MT6768 connectivity subsystem (CONNSYS)

maintainers:
  - Marcus Ramberg <marcus@means.no>

description:
  CONNSYS holds Bluetooth, Wi-Fi, GPS and FM, which share one MCU and the
  MT6631 RF die (A-die). The MCU runs from host memory, which infracfg
  maps into its address space; the host reaches it over BTIF. The
  Bluetooth node under BTIF refers to this node, see
  Documentation/devicetree/bindings/net/bluetooth/mediatek,mt6768-bluetooth.yaml.

properties:
  compatible:
    const: mediatek,mt6768-connsys

  reg:
    maxItems: 1

  interrupts:
    items:
      - description: BTIF wakeup, raised when the MCU has data for the host
      - description: MCU software interrupt

  interrupt-names:
    items:
      - const: wakeup
      - const: sw

  mediatek,infracfg:
    $ref: /schemas/types.yaml#/definitions/phandle
    description: infracfg_ao, which maps memory-region and pericfg into
      the MCU's address space.

  memory-region:
    maxItems: 1
    description: Memory the MCU runs from. It must be aligned to 16 MiB,
      the granularity of the mapping.

  power-domains:
    maxItems: 1

  resets:
    items:
      - description: MCU reset
      - description: Subsystem reset

  reset-names:
    items:
      - const: cpu
      - const: sw

  vcn18-supply:
    description: 1.8 V supply of the subsystem and the A-die.

  vcn28-supply:
    description: 2.8 V A-die supply, needed while the A-die calibrates.

  vcn33-supply:
    description: 3.3 V supply of the Bluetooth and Wi-Fi RF front ends.

required:
  - compatible
  - reg
  - interrupts
  - interrupt-names
  - mediatek,infracfg
  - memory-region
  - power-domains
  - resets
  - reset-names
  - vcn18-supply
  - vcn28-supply
  - vcn33-supply

additionalProperties: false

examples:
  - |
    #include <dt-bindings/interrupt-controller/arm-gic.h>
    #include <dt-bindings/interrupt-controller/irq.h>
    #include <dt-bindings/reset/mt8183-resets.h>

    connectivity@18000000 {
        compatible = "mediatek,mt6768-connsys";
        reg = <0x18000000 0x100000>;
        interrupts = <GIC_SPI 284 IRQ_TYPE_LEVEL_LOW>,
                     <GIC_SPI 287 IRQ_TYPE_EDGE_FALLING>;
        interrupt-names = "wakeup", "sw";
        mediatek,infracfg = <&infracfg_ao>;
        memory-region = <&connsys_mem>;
        power-domains = <&spm 1>;
        resets = <&toprgu MT8183_TOPRGU_CONN_MCU_SW_RST>,
                 <&toprgu MT8183_TOPRGU_CONN_SW_RST>;
        reset-names = "cpu", "sw";
        vcn18-supply = <&mt6358_vcn18_reg>;
        vcn28-supply = <&mt6358_vcn28_reg>;
        vcn33-supply = <&mt6358_vcn33_reg>;
    };
```

## drivers/media/platform/mediatek/isp/Kconfig
```kconfig
# SPDX-License-Identifier: GPL-2.0-only
config MTK_SENINF30
	tristate "MediaTek ISP3.0 SENINF driver"
	depends on ARCH_MEDIATEK || COMPILE_TEST
	depends on OF
	select MEDIA_CONTROLLER
	select PHY_MTK_MIPI_CSI_0_5
	select V4L2_FWNODE
	select VIDEO_V4L2_SUBDEV_API
	default n
	help
	  This driver provides a MIPI CSI-2 receiver interface to connect
	  an external camera module with MediaTek ISP3.0. It is able to handle
	  multiple cameras at the same time.

	  To compile this driver as a module, choose M here: the
	  module will be called mtk-seninf.
```

## sound/soc/apple/Kconfig
```kconfig
# SPDX-License-Identifier: GPL-2.0-only
menu "Apple"

config SND_SOC_APPLE_MCA
	tristate "Apple Silicon MCA driver"
	depends on ARCH_APPLE || COMPILE_TEST
	select SND_DMAENGINE_PCM
	help
	  This option enables an ASoC platform driver for MCA peripherals found
	  on Apple Silicon SoCs.

config SND_SOC_APPLE_D431
	tristate "Apple D431 (iPhone 11 Pro Max) sound card"
	depends on SND_SOC_APPLE_MCA && APPLE_SIO && I2C && SPI
	select COMMON_CLK_APPLE_NCO
	select SND_SOC_CS35L27
	select SND_SOC_CS42L77
	help
	  Sound card for the top speaker of the iPhone 11 Pro Max.

endmenu
```
